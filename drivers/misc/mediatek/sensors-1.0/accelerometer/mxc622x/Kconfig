## drivers/misc/mediatek/sensors-1.0/accelerometer/mxc622x/Kconfig
```kconfig
config MTK_MXC622X
	bool "for support MXC622X gsensor"
	default n
	help
		This configuration is for enable or disable MXC622X accelerometer sensor support.
		Say Y here if you want to support this sensor.
		Say N if you not support it.
		If no sure, say N.
```
